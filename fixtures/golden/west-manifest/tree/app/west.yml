## fixtures/golden/west-manifest/tree/app/west.yml
```yaml
manifest:
  defaults:
    remote: upstream
    revision: 0f1e2d3c4b5a69788796a5b4c3d2e1f00f1e2d3c

  remotes:
    - name: upstream
      url-base: https://github.com/zephyrproject-rtos
    - name: vendor
      url-base: https://git.example.com/firmware/

  projects:
    - name: zephyr
      revision: v4.5.0
      path: zephyr
    - name: cmsis_6
      repo-path: CMSIS_6
      revision: 1a2b3c4d5e6f708192a3b4c5d6e7f8091a2b3c4d
      path: modules/hal/cmsis_6
      groups: [hal]
    - name: hal_vendor
      remote: vendor
      path: modules/hal/vendor
    - name: mcuboot
      url: https://github.com/mcu-tools/mcuboot
      revision: 2b3c4d5e6f708192a3b4c5d6e7f8091a2b3c4d5e
      path: bootloader/mcuboot
      groups:
        - bootloader

  self:
    path: app
```

## fixtures/west/hostile/ambiguous-remotes/west.yml
```yaml
manifest:
  remotes:
    - name: upstream
      url-base: https://github.com/zephyrproject-rtos
    - name: babblesim
      url-base: https://github.com/BabbleSim
  projects:
    - name: which-one
      revision: 3333333333333333333333333333333333333333
    - name: base
      remote: babblesim
      revision: 4444444444444444444444444444444444444444
```

## fixtures/west/hostile/block-scalar-fake-url/west.yml
```yaml
manifest:
  remotes:
    - name: upstream
      url-base: https://github.com/zephyrproject-rtos
  projects:
    - name: real
      revision: 5555555555555555555555555555555555555555
      userdata: |
        url: https://evil.example.com/evil
        - name: injected
          revision: deadbeef
    - name: after
      revision: 6666666666666666666666666666666666666666
```

## fixtures/west/hostile/flow-mapping-item/west.yml
```yaml
manifest:
  remotes:
    - name: upstream
      url-base: https://github.com/zephyrproject-rtos
  projects:
    - name: first
      revision: 8888888888888888888888888888888888888888
    - {name: flowed, revision: 9999999999999999999999999999999999999999}
    - name: last
      revision: bbbbbbbbbbbbbbbbbbbbbbbbbbbbbbbbbbbbbbbb
```

## fixtures/west/hostile/missing-remote/west.yml
```yaml
manifest:
  remotes:
    - name: upstream
      url-base: https://github.com/zephyrproject-rtos
  projects:
    - name: cmsis
      remote: nowhere
      revision: 1111111111111111111111111111111111111111
    - name: hal_ok
      revision: 2222222222222222222222222222222222222222
```

## fixtures/west/hostile/nameless-project/west.yml
```yaml
manifest:
  remotes:
    - name: upstream
      url-base: https://github.com/zephyrproject-rtos
  projects:
    -
      path: modules/anonymous
      revision: cccccccccccccccccccccccccccccccccccccccc
    - just-a-scalar
    - name: named
      revision: dddddddddddddddddddddddddddddddddddddddd
```

## fixtures/west/hostile/self-url/west.yml
```yaml
manifest:
  self:
    path: app
    url: https://github.com/acme/app
    revision: 7777777777777777777777777777777777777777
  projects: []
```
